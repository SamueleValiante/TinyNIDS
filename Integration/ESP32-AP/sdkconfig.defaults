## Integration/ESP32-AP/sdkconfig.defaults
```kconfig
CONFIG_FREERTOS_HZ=1000 
CONFIG_LWIP_IP_FORWARD=y 
CONFIG_LWIP_IPV4_NAPT=y 
CONFIG_ARDUINO_SELECTIVE_COMPILATION=y
CONFIG_ARDUINO_SELECTIVE_WiFi=y
```
